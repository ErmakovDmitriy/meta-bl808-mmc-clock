## conf/layer.conf
```bitbake
# We have a conf and classes directory, add to BBPATH
BBPATH .= ":${LAYERDIR}"

# We have recipes-* directories, add to BBFILES
BBFILES += "${LAYERDIR}/recipes-*/*/*.bb \
            ${LAYERDIR}/recipes-*/*/*.bbappend"

BBFILE_COLLECTIONS += "meta-bl808-mmc-clock"
BBFILE_PATTERN_meta-bl808-mmc-clock = "^${LAYERDIR}/"
BBFILE_PRIORITY_meta-bl808-mmc-clock = "8"

LAYERDEPENDS_meta-bl808-mmc-clock = "core"
LAYERSERIES_COMPAT_meta-bl808-mmc-clock = "kirkstone mickledore"

# UBOOT_EXTLINUX_KERNEL_ARGS = "ss ${bootargs} "
```
